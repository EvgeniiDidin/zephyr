## samples/smp/pktqueue/sample.yaml
```yaml
sample:
  description: Processing multiple queues in
    a number of threads
  name: SMP Pktqueue
common:
    tags: introduction
    harness: console
    harness_config:
      type: multi_line
      ordered: yes
      regex:
        - "Simulating IP header validation on multiple cores.(.*)"
        - "Each of [0-9]+ parallel queues is processed by [0-9]+ threads and contain [0-9]+ packet headers.(.*)"
        - "Bytes in packet header: [0-9]+(.*)"
        - "All [0-9] packet headers were processed in [0-9]+ msec.(.*)"
tests:
  sample.smp.pktqueue:
    tags: introduction
    filter: (CONFIG_MP_NUM_CPUS > 1)
```
